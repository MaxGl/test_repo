## configs/test_defconfig
```kconfig
CONFIG_DEBUG=y
CONFIG_COMPONENT_A=y
CONFIG_COMPONENT_B=y
CONFIG_COMPONENT_LIBA=y
CONFIG_EXTERNAL_OEMSDK=y
CONFIG_EXTERNAL_OEMSDK_ARTIFACTORY_VERSION=3.5.16 # overrides artifactory option in build file
CONFIG_EXTERNAL_CHROME=y

CONFIG_EXTERNAL_EXTLIBF=y
CONFIG_EXTERNAL_EXTLIBF_USE_SOURCES=y # alters use_sources flag in build file
```
